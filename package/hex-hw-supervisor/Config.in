## package/hex-hw-supervisor/Config.in
```kconfig
config BR2_PACKAGE_HEX_HW_SUPERVISOR
	bool "hex-hw-supervisor"
	depends on BR2_PACKAGE_HOST_RUSTC_TARGET_ARCH_SUPPORTS
	select BR2_PACKAGE_HOST_RUSTC
	select BR2_PACKAGE_HEX_ROBOT_PROTO
	help
	  Open-source controller-level hardware supervisor: drives the
	  board's on-board peripherals (IMU / estop / remote / vbus ...)
	  per the board config (/etc/hexmeow/board.yaml) and publishes
	  them on the <vendor>/<cid>/hw/** zenoh keyspace, with per-
	  resource liveliness and a hw/info capability queryable.

	  Design: robot-overall-design/09-controller-hal.md. Source
	  lives in this BR2_EXTERNAL tree (hex-hw-supervisor/).
```

## package/hex-robot-proto/Config.in
```kconfig
config BR2_PACKAGE_HEX_ROBOT_PROTO
	bool "hex-robot-proto"
	help
	  hex-meow public protobuf contract (.proto files, SHA-pinned).
	  Staging-only: consumed at build time by hex-hw-supervisor (and
	  any future on-image component speaking the robot API).

	  https://github.com/hex-meow/hex-robot-proto
```

## package/hex-wifi/Config.in
```kconfig
config BR2_PACKAGE_HEX_WIFI
	bool "hex-wifi"
	depends on BR2_USE_MMU
	depends on BR2_TOOLCHAIN_HAS_THREADS
	depends on BR2_PACKAGE_HOST_RUSTC_TARGET_ARCH_SUPPORTS
	select BR2_PACKAGE_HOST_RUSTC
	select BR2_PACKAGE_WPA_SUPPLICANT
	select BR2_PACKAGE_WPA_SUPPLICANT_CTRL_IFACE
	select BR2_PACKAGE_WPA_SUPPLICANT_NL80211
	help
	  Public Wi-Fi provisioning service and local CLI for Hex Meow
	  controllers. It owns Wi-Fi configuration transactions and exposes
	  a bounded request/reply protocol over a protected Unix socket. The
	  production backend uses the native wpa_supplicant control socket.

	  https://github.com/hex-meow/hex-wifi
```

## package/zenohd/Config.in
```kconfig
config BR2_PACKAGE_ZENOHD
	bool "zenohd"
	depends on BR2_PACKAGE_HOST_RUSTC_TARGET_ARCH_SUPPORTS
	select BR2_PACKAGE_HOST_RUSTC
	help
	  Eclipse Zenoh router daemon. Runs as the robot-local hub
	  (systemd unit "zenohd.service"): all on-board processes
	  (hardware supervisor, robot controllers) connect to it as
	  clients on localhost; host PCs / GUIs / ROS2 bridges reach
	  the robot through its LAN listener.

	  Built natively by buildroot (glibc) so it always matches the
	  image ABI. Note: upstream's *-musl-standalone release binary
	  is dynamically linked against musl and cannot run on this
	  image — do not substitute it.

	  https://github.com/eclipse-zenoh/zenoh
```
